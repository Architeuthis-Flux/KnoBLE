## modules/knob-engine/dts/bindings/input/baseline,knob-engine.yaml
```yaml
description: |
  BaselineDesign KnoBLE knob engine: polls an AS5600 absolute angle sensor,
  quantizes rotation into virtual detents, emits input events or keycodes,
  and fires DRV2605 haptic effects per detent. Child nodes define per-layer
  profiles; the highest active layer with a matching profile wins, falling
  back to the first profile.

compatible: "baseline,knob-engine"

properties:
  sensor:
    type: phandle
    required: true
    description: AS5600 (or any SENSOR_CHAN_ROTATION absolute-angle) sensor device

  haptics:
    type: phandle
    description: DRV2605 haptic driver device (badjeff/zmk-drv2605-driver)

  led-strip:
    type: phandle
    description: |
      LED strip the engine drives as a speed gauge (blue = slowest divider,
      green = 1x, red = fastest multiplier). Takes exclusive ownership —
      disable ZMK RGB underglow when using this.

  poll-hz:
    type: int
    default: 250
    description: sensor poll rate while the keyboard is active

  idle-poll-hz:
    type: int
    default: 25
    description: sensor poll rate while the keyboard is idle

  invert:
    type: boolean
    description: flip the rotation direction

  slider-channels:
    type: array
    description: |
      SAADC AIN channel indexes with slider potentiometers attached
      (pro micro A1=AIN0, A2=AIN5, A3=AIN7). Omit if no sliders populated.

  slider-deadband:
    type: int
    default: 24
    description: raw ADC counts of hysteresis before a slider change registers

  wheel-report-interval-ms:
    type: int
    default: 30
    description: |
      Minimum spacing between emitted wheel reports; detent output within a
      window is summed into one event. Caps the HID event rate so host-side
      scroll acceleration (e.g. macOS) doesn't amplify fast knob spins.
      Total scroll distance is unaffected.

  wheel-max-lines-per-report:
    type: int
    default: 0
    description: unused since the unit-event drip; kept for config compatibility

  wheel-queue-max:
    type: int
    default: 32
    description: |
      Max scroll units queued for the drip. Units beyond this are dropped so
      a hard flick can't bank output that keeps scrolling after the knob
      stops. Also the effective velocity ceiling together with
      wheel-report-interval-ms (rate = 1000/interval events per second).

child-binding:
  description: Per-layer knob profile

  properties:
    layer:
      type: int
      required: true
      description: ZMK layer index this profile is active on

    mode:
      type: string
      default: "scroll"
      enum: ["scroll", "keycode", "bounded"]
      description: |
        scroll  - emit relative input events (input-code) per detent
        keycode - tap cw-code / ccw-code (ZMK keymap encodings) per detent
        bounded - like scroll but clamped to [range-min, range-max] with an
                  end-stop haptic at the limits

    detents-per-rev:
      type: int
      default: 24
      description: haptic/texture grid; also the output step for keycode and bounded modes

    lines-per-rev:
      type: int
      default: 0
      description: |
        Scroll-mode output resolution, decoupled from the detent grid: lines
        emitted per full revolution at 1x speed. Finer than detents-per-rev
        keeps the page tracking the knob between clicks. 0 = one line per
        detent (legacy coupling).

    haptic-effect:
      type: int
      default: 0
      description: TI waveform library effect ID fired per detent (0 = none)

    input-code:
      type: int
      default: 8
      description: input event code for scroll/bounded mode (default REL_WHEEL)

    cw-code:
      type: int
      default: 0
      description: ZMK keymap encoding (e.g. C_VOL_UP) tapped on clockwise detents

    ccw-code:
      type: int
      default: 0
      description: ZMK keymap encoding tapped on counter-clockwise detents

    range-min:
      type: int
      default: 0

    range-max:
      type: int
      default: 100

    endstop-effect:
      type: int
      default: 0
      description: TI effect ID fired when a bounded value hits its limit

    slider-role:
      type: string
      default: "none"
      enum: ["none", "wheel-scale", "own-control"]
      description: |
        none        - sliders ignored in this profile
        wheel-scale - slider position scales detent output 1x..wheel-scale-max
        own-control - slider movement emits its own input events

    slider-index:
      type: int
      default: 0
      description: index into slider-channels used by this profile

    slider-input-code:
      type: int
      default: 6
      description: input event code for own-control slider (default REL_HWHEEL)

    slider-steps:
      type: int
      default: 32
      description: quantization buckets across the slider travel (own-control)

    slider-effect:
      type: int
      default: 0
      description: TI effect ID fired per slider step (0 = none)

    wheel-scale-max:
      type: int
      default: 4
      description: max multiplier when slider-role is wheel-scale (slider at top)

    wheel-scale-min-div:
      type: int
      default: 1
      description: |
        max divider when slider-role is wheel-scale (slider at bottom):
        the knob emits one output per this many detents. 1 = low end is
        normal 1x speed (no sub-speed range).

    slider-curve-power:
      type: int
      default: 1
      description: |
        Response curve of the wheel-scale slider. 1 = linear travel across
        the speed notches; 2 (quadratic) or 3 (cubic) bias most of the pot
        travel toward the slow end, reaching the top multipliers only when
        cranked.
```
